/dts-v1/;
/plugin/;
/ {
	/* Raspberry Pi 3 */
	compatible = "brcm,bcm2837";

	fragment@0 {
		target = <&i2c1>;
		__overlay__ {
			#address-cells = <1>;
			#size-cells = <0>;
            status = "okay";

			customlps25hb: customlps25hb@5d {
                compatible = "mr,customlps25hb";
                reg = <0x5d>;
                status = "okay";
            };
		};
	};
};